VERSION ""

NS_ :

BS_:

BU_:

BO_ 1702 Main_Battery_Temperature_C: 8 Vector__XXX
 SG_ Main_Battery_Temperature_C : 0|24@1+ (0.5,-40) [-40|87.5] "degC" Vector__XXX

BA_DEF_ BO_  "GenMsgCycleTime" INT 0 10000;
BA_DEF_DEF_  "GenMsgCycleTime" 0;

BA_ "GenMsgCycleTime" BO_ 1702 50;
